## boards/shields/miiUnic/Kconfig.shield
```kconfig
# Copyright (c) 2024 Curtis Bollinger
# SPDX-License-Identifier: MIT

config SHIELD_MIIUNIC_LEFT
    def_bool $(shields_list_contains,miiUnic_left)

config SHIELD_MIIUNIC_RIGHT
    def_bool $(shields_list_contains,miiUnic_right)
```

## config/boards/shields/miiUnic/Kconfig.defconfig
```kconfig
if SHIELD_miiUnic_LEFT

# Name must be less than 16 characters long!
config ZMK_KEYBOARD_NAME
    default "miiUnic"

config ZMK_SPLIT_ROLE_CENTRAL
    default y

endif

if SHIELD_miiUnic_LEFT || SHIELD_miiUnic_RIGHT

config ZMK_SPLIT
    default y

endif
```

## config/boards/shields/miiUnic/Kconfig.shield
```kconfig
# No whitespace after the comma or in your part name!
config SHIELD_miiUnic_LEFT
    def_bool $(shields_list_contains,miiUnic_left)

# No whitespace after the comma or in your part name!
config SHIELD_miiUnic_RIGHT
    def_bool $(shields_list_contains,miiUnic_right)
```
